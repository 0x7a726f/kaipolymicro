/*
 * main.s
 *
 *  Created on: May 24, 2026
 *      Author: karga
 */
.syntax unified
.cpu cortex-m4
.thumb

.text
.global main
.thumb_func

main:
    @ 1. Clock για GPIOD
    @ =========================================================================
    ldr r0, =0x40023830      @ Διεύθυνση RCC_AHB1ENR
    ldr r1, [r0]
    orr r1, r1, #0x08        @ Bit 3 = 1 (Ενεργοποίηση GPIOD Clock)
    str r1, [r0]

    @ Ρύθμιση GPIOD_MODER: Τα Pins 0-15 ως Outputs (Τιμή 0x55555555)
    ldr r0, =0x40020000 + 0x0C00  @ 0x40020C00 (GPIOD_MODER)
    ldr r1, =0x55555555
    str r1, [r0]

    @ ΕΡΩΤΗΜΑ (α): Αποθήκευση αριθμών 0-255 με φθίνουσα σειρά (μέγεθος λέξης)
    @ =========================================================================
    ldr r0, =0x20000900      @ r0 = Αρχική διεύθυνση SRAM
    mov r1, #255             @ r1 = Μετρητής / Τιμή προς αποθήκευση (255 έως 0)

store_loop:
    str r1, [r0], #4         @ Αποθήκευση του r1 ως Word (4 bytes) και Post-index offset +4 για τις επόμενες θέσεις
    subs r1, r1, #1          @ Μείωση της τιμής κατά 1
    bpl store_loop           @ Branch αν το αποτέλεσμα είναι θετικό ή μηδέν (Positive or Zero, έως και το 0)

    @ ΕΡΩΤΗΜΑ (γ): Μέτρηση αριθμών στο εύρος 0x10 <= x <= 0x80
    @ =========================================================================
    ldr r0, =0x20000900      @ Επανέφερε τον r0 στην αρχική διεύθυνση της SRAM
    mov r1, #256             @ r1 = Πλήθος στοιχείων για έλεγχο (256 λέξεις)
    mov r3, #0               @ r3 = Μετρητής αριθμών που ικανοποιούν τη συνθήκη

process_loop:
    ldr r4, [r0], #4         @ Φόρτωσε την τρέχουσα λέξη (32-bit) στον r4 και προχώρα στην επόμενη

    @ Έλεγχος Εύρους 0x10 <= x <= 0x80
    @ -------------------------------------------------------------------------
    cmp r4, #0x10            @ Σύγκρινε τον αριθμό με το κάτω όριο (0x10)
    blt next_element         @ Αν x < 0x10, προσπέρνα τον αριθμό
    cmp r4, #0x80            @ Σύγκρινε τον αριθμό με το πάνω όριο (0x80)
    bgt next_element         @ Αν x > 0x80, προσπέρνα τον αριθμό

    add r3, r3, #1           @ Αν 0x10 <= x <= 0x80, αύξησε τον μετρητή κατά 1

next_element:
    subs r1, r1, #1          @ Μείωση του μετρητή των 256 στοιχείων μνήμης
    bne process_loop         @ Επανάληψη για την επόμενη λέξη

    @ Αποτέλεσμα στο GPIOD_ODR
    @ =========================================================================
    ldr r7, =0x40020C14      @ Διεύθυνση του GPIOD_ODR

    @ Εμφάνιση της τιμής του καταχωρητή r3 (113 / 0x0071) στα LEDs της θύρας
    str r3, [r7]             @ Έξοδος στη θύρα GPIOD

infinite_loop:
    b infinite_loop          @ Τέλος προγράμματος
