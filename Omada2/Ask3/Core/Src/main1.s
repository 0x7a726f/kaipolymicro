/*
 * main.s
 *
 * Created on: May 24, 2026
 * Author: karga
 */

.syntax unified
.cpu cortex-m4
.thumb

.text
.global main1
.thumb_func

main1:
    @ 1. Clock για GPIOD
    @ =========================================================================
    ldr r0, =0x40023830      @ Διεύθυνση RCC_AHB1ENR
    ldr r1, [r0]
    orr r1, r1, #0x08        @ Bit 3 = 1 (Ενεργοποίηση GPIOD Clock)
    str r1, [r0]

    @ Ρύθμιση GPIOD_MODER: Τα Pins 0-15 ως Outputs (Τιμή 0x55555555)
    ldr r0, =0x40020000 + 0x0C00  @ 0x40020C00 (GPIOD_MODER)
    ldr r1, =0x55555555
    str r1, [r0]

    @ ΕΡΩΤΗΜΑ (α): Αποθήκευση αριθμών 0-255 με φθίνουσα σειρά (μέγεθος λέξης)
    @ =========================================================================
    ldr r0, =0x20000900      @ r0 = Αρχική διεύθυνση SRAM (VMA)
    mov r1, #255             @ r1 = Μετρητής / Τιμή προς αποθήκευση (255 έως 0)

store_loop:
    str r1, [r0], #4         @ Αποθήκευση του r1 ως Word (4 bytes) και Post-index offset +4 για τα επόμενα bytes
    subs r1, r1, #1          @ Μείωση της τιμής κατά 1
    bpl store_loop           @ Branch αν το αποτέλεσμα είναι θετικό ή μηδέν (Positive or Zero, έως 0)


    @ ΕΡΩΤΗΜΑ (β): Επεξεργασία και καταμέτρηση των δυαδικών μηδενικών
    @ =========================================================================
    ldr r0, =0x20000900      @ Επανέφερε τον r0 στην αρχή της λίστας
    mov r1, #256             @ r1 = Πλήθος στοιχείων για έλεγχο (256 λέξεις)
    mov r2, #0               @ r2 = Συνολικός μετρητής δυαδικών ΜΗΔΕΝΙΚΩΝ (Ερώτημα β)

process_loop:
    ldr r4, [r0], #4         @ Φόρτωσε την τρέχουσα λέξη στον r4 και προχώρα στην επόμενη

    @ Υπολογισμός Μηδενικών με bit-by-bit έλεγχο και των 32 bits της λέξης
    @ -------------------------------------------------------------------------
    mov r5, #32              @ r5 = Μετρητής bits για τη συγκεκριμένη λέξη
    mov r6, r4               @ r6 = Αντίγραφο της λέξης για ολίσθηση

count_bits_loop:
    lsrs r6, r6, #1          @ Ολίσθηση δεξιά κατά 1 bit. Το LSB πάει στο Carry flag (C)
    bcs skip_zero            @ Αν C == 1 (ήταν άσσος), πήγαινε στο skip_zero
    add r2, r2, #1           @ Αν C == 0 (ήταν μηδέν), αύξησε τον καθολικό μετρητή μηδενικών
skip_zero:
    subs r5, r5, #1          @ Μείωση των εναπομείναντων bits
    bne count_bits_loop      @ Συνέχισε μέχρι να ελεγχθούν και τα 32 bits της λέξης

next_element:
    subs r1, r1, #1          @ Μείωση του μετρητή των 256 στοιχείων
    bne process_loop         @ Επανάληψη για το επόμενο στοιχείο

    @ Αποτέλεσμα στο GPIOD_ODR (Ερώτημα β)
    @ =========================================================================
    ldr r7, =0x40020C14      @ Διεύθυνση του GPIOD_ODR

    @ Εμφανίζουμε αυτούσιο τον καταχωρητή r2 (που περιέχει το 7168 / 0x1C00)
    @ ώστε να ανάψουν σωστά τα αντίστοιχα LED χωρίς λογικά "κουρέματα" bits.
    str r2, [r7]             @ Έξοδος στα LEDs του GPIOD

infinite_loop:
    b infinite_loop          @ Τέλος προγράμματος
